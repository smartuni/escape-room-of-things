## Nodes/example/boards/example_board/Kconfig
```kconfig
# Copyright (c) 2020 HAW Hamburg
#
# This file is subject to the terms and conditions of the GNU Lesser
# General Public License v2.1. See the file LICENSE in the top level
# directory for more details.

config BOARD
    default "example_board" if BOARD_EXAMPLE_BOARD

config BOARD_EXAMPLE_BOARD
    bool
    default y
    select BOARD_NRF52840DONGLE

source "$(RIOTBOARD)/boards/nrf52840dongle/Kconfig"
```
